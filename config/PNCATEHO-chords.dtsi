#include "PNCATEHO-chords-engine.dtsi"

//    (name,   press,       inner,         out,         both,          chord)
TCOMBO(B,      &kp B,       &kp LS(B),     &kp LEFT,    &kp LS(LEFT),  SN)
TCOMBO(F,      &kp F,       &kp LS(F),     &kp UP,      &kp LS(UP),    SA)
TCOMBO(T,      &kp T,       &kp LS(T),     &kp DOWN,    &kp LS(DOWN),  SE)
TCOMBO(J,      &kp J,       &kp LS(J),     &kp RIGHT,   &kp LS(RIGHT), SO)
TCOMBO(H,      &kp H,       &kp LS(H),     &sk LGUI,    &kp HOME,      SP)
TCOMBO(C,      &kp C,       &kp LS(C),     &sk LALT,    &kp PG_UP,     SC)
TCOMBO(N,      &kp N,       &kp LS(N),     &sk LCTRL,   &kp PG_DN,     ST)
TCOMBO(Y,      &kp Y,       &kp LS(Y),     &sk LSHIFT,  &kp END,       SH)
TCOMBO(D,      &kp D,       &kp LS(D),     &kp N1,      &kp F1,        SN SO)
TCOMBO(K,      &kp K,       &kp LS(K),     &kp N2,      &kp F2,        SP SH)
TCOMBO(R,      &kp R,       &kp LS(R),     &kp N3,      &kp F3,        SP SC)
TCOMBO(V,      &kp V,       &kp LS(V),     &kp N4,      &kp F4,        ST SH)
TCOMBO(L,      &kp L,       &kp LS(L),     &kp N5,      &kp F5,        SN SA)
TCOMBO(G,      &kp G,       &kp LS(G),     &kp N6,      &kp F6,        SE SO)
TCOMBO(E,      &kp E,       &kp LS(E),     &kp N7,      &kp F7,        SC ST)
TCOMBO(Z,      &kp Z,       &kp LS(Z),     &kp N8,      &kp F8,        SA SE)
TCOMBO(S,      &kp S,       &kp LS(S),     &kp N9,      &kp F9,        SP ST)
TCOMBO(M,      &kp M,       &kp LS(M),     &kp N0,      &kp F10,       SC SH)
TCOMBO(U,      &kp U,       &kp LS(U),     &kp EXCL,    &kp F11,       SN SE)
TCOMBO(P,      &kp P,       &kp LS(P),     &kp AT,      &kp F12,       SA SO)
TCOMBO(COMMA,  &kp COMMA,   &kp LS(COMMA), &kp HASH,    &none,         SN SH)
TCOMBO(X,      &kp X,       &kp LS(X),     &kp DLLR,    &none,         SP SO)
TCOMBO(Q,      &kp Q,       &kp LS(Q),     &kp PRCNT,   &none,         SN ST)
TCOMBO(LBKT,   &kp LBKT,    &kp LS(LBKT),  &kp CARET,   &none,         SC SO)
TCOMBO(SEMI,   &kp SEMI,    &kp LS(SEMI),  &kp AMPS,    &none,         SP SE)
TCOMBO(I,      &kp I,       &kp LS(I),     &kp STAR,    &none,         SA SH)
TCOMBO(DOT,    &kp DOT,     &kp LS(DOT),   &kp LPAR,    &none,         SN SC)
TCOMBO(W,      &kp W,       &kp LS(W),     &kp RPAR,    &none,         SO ST)
TCOMBO(O,      &kp O,       &kp LS(O),     &kp SLASH,   &none,         SA ST)
TCOMBO(SQT,    &kp SQT,     &kp LS(SQT),   &kp QMARK,   &none,         SE SC)
TCOMBO(A,      &kp A,       &kp LS(A),     &kp MINUS,   &none,         SE SH)
TCOMBO(RBKT,   &kp RBKT,    &kp LS(RBKT),  &kp UNDER,   &none,         SA SP)
TCOMBO(GRAVE,  &kp GRAVE,   &kp LS(GRAVE), &kp EQUAL,   &none,         SA SE SO)
TCOMBO(NUBS,   &kp NUBS,    &kp LS(NUBS),  &kp PLUS,    &none,         SC ST SH)
TCOMBO(DEL,    &kp DEL,     &none,         &kp LC(DEL), &none,         SA SC)
TCOMBO(ESC,    &kp ESC,     &none,         &kp N1,      &none,         SE ST)
TCOMBO(TAB,    &kp TAB,     &kp LA(TAB),   &kp LC(TAB), &none,         SN SP)
TCOMBO(ENTER,  &kp ENTER,   &kp LS(ENTER), &none,       &none,         SO SH)

TCOMBO(SLCT,   &to SELECTION_LAYER, &none, &none,       &none,   SN SA SE SO)

